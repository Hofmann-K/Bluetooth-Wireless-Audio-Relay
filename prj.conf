## prj.conf
```kconfig
# Enable DK LED and Buttons library
CONFIG_GPIO=y
CONFIG_DK_LIBRARY=y

# Configure logger
CONFIG_LOG=y
CONFIG_USE_SEGGER_RTT=n
CONFIG_LOG_BACKEND_RTT=n
CONFIG_LOG_BACKEND_UART=y
CONFIG_LOG_DEFAULT_LEVEL=3

# remote.h requires Bluetooth to be enabled by BT_CONFIG in order to be built
# in order to use <zephyr/bluetooth/bluetooth.h>

# Config Bluetooth (Highlight variables for more info)
# Enable BT Stack
CONFIG_BT=y
# Support the 'Peripheral' role and/or the 'Central" role
CONFIG_BT_PERIPHERAL=y
CONFIG_BT_DEVICE_NAME="Remote_controller"
# Discoverable as <device> based on value. EX: Smartwatch, phone, microcontroller, etc.
CONFIG_BT_DEVICE_APPEARANCE=0
CONFIG_BT_MAX_CONN=1
# Link Layer to allow use of the nRF controller
CONFIG_BT_LL_SOFTDEVICE=y

# We want to assert enables the __ASSERT() macro in the kernel code. Otherwise encounter fatal error
CONFIG_ASSERT=y
```

## src/main.c
```c
/*
 * Copyright (c) 2012-2014 Wind River Systems, Inc.
 *
 * SPDX-License-Identifier: Apache-2.0
 */

#include <zephyr/kernel.h>
#include <zephyr/logging/log.h>
#include <dk_buttons_and_leds.h>
#include "remote.h"

#define LOG_MODULE_NAME app
LOG_MODULE_REGISTER(LOG_MODULE_NAME);

#define RUN_STATUS_LED DK_LED1
#define CONN_STATUS_LED DK_LED2
#define RUN_LED_BLINK_INTERVAL 1000


void button_handler(uint32_t button_state, uint32_t has_changed)
{
	int button_pressed = 0;
	if (has_changed & button_state)
	{
		switch (has_changed)
		{
			case DK_BTN1_MSK:
				button_pressed = 1;
				break;
			case DK_BTN2_MSK:
				button_pressed = 2;
				break;
			case DK_BTN3_MSK:
				button_pressed = 3;
				break;
			case DK_BTN4_MSK:
				button_pressed = 4;
				break;
			default:
				break;
		}
		LOG_INF("Button %d pressed.", button_pressed);
	}
}

/* Configurations */

static void configure_dk_buttons_leds(void)
{
	int err;

	err = dk_buttons_init(button_handler);
	if (err)
	{
		LOG_ERR("Cannot init buttons (err: %d)", err);
	}
	err = dk_leds_init();
	if (err)
	{
		LOG_ERR("Cannot init LEDs (err: %d)", err);
	}
}

/* main */

void main(void)
{
	int err;
	int blink_status = 0;
	LOG_INF("Hello World! %s\n", CONFIG_BOARD);

	configure_dk_buttons_leds();

	err = bluetooth_init();
	if (err) {
		LOG_ERR("Bluetooth_init returned %d", err);
	}

	LOG_INF("Running...");
	for (;;) {
		dk_set_led(RUN_STATUS_LED, (blink_status++)%2);
		k_sleep(K_MSEC(RUN_LED_BLINK_INTERVAL));
	}
}
```
